## conf/layer.conf
```bitbake
# We have a conf and classes directory, add to BBPATH
BBPATH .= ":${LAYERDIR}"

# We have recipes-* directories, add to BBFILES
BBFILES += "${LAYERDIR}/recipes-*/*/*.bb ${LAYERDIR}/recipes-*/*/*.bbappend"

BBFILE_COLLECTIONS += "meta-cheri"
BBFILE_PATTERN_meta-cheri = "^${LAYERDIR}/"
BBFILE_PRIORITY_meta-cheri = "15"

BBFILES_DYNAMIC += " \
    openembedded-layer:${LAYERDIR}/dynamic-layers/openembedded-layer/*/*/*.bb \
    openembedded-layer:${LAYERDIR}/dynamic-layers/openembedded-layer/*/*/*.bbappend \
    gnome-layer:${LAYERDIR}/dynamic-layers/gnome-layer/*/*/*.bbappend \
    networking-layer:${LAYERDIR}/dynamic-layers/networking-layer/*/*/*.bbappend \
    multimedia-layer:${LAYERDIR}/dynamic-layers/multimedia-layer/*/*/*.bbappend \
"

LAYERDEPENDS_meta-cheri = " core clang-layer"

# This should only be incremented on significant changes that will
# cause compatibility issues with other layers
LAYERVERSION_meta-cheri = "1"

LAYERSERIES_COMPAT_meta-cheri = "scarthgap"

# Support for Cheri
INHERIT:prepend = "cheri "

# This needs to be set here, before we include tclibc-glibc.inc
TCLIBC = "musl"

META_CHERI_FILES_DIR = "${LAYERDIR}/files"

META_CHERI_BUSYBOX_REPO ?= "github.com/CHERI-Alliance/busybox.git"
META_CHERI_BUSYBOX_BRANCH ?= "codasip-cheri-riscv-1_36_1"
META_CHERI_BUSYBOX_PROTOCOL ?= "https"

META_CHERI_GDB_REPO = "github.com/CHERI-Alliance/gdb.git"
META_CHERI_GDB_BRANCH = "codasip-cheri-riscv"
META_CHERI_GDB_PROTOCOL = "https"

META_CHERI_LINUX_REPO ?= "github.com/CHERI-Alliance/linux.git"
META_CHERI_LINUX_BRANCH ?= "codasip-cheri-riscv-6.18"
META_CHERI_LINUX_PROTOCOL ?= "https"

META_CHERI_LLVM_PROJECT_REPO ?= "github.com/CHERI-Alliance/llvm-project.git"
META_CHERI_LLVM_PROJECT_BRANCH ?= "codasip-cheri-riscv-19"
META_CHERI_LLVM_PROJECT_PROTOCOL ?= "https"

META_CHERI_LTP_REPO ?= "github.com/CHERI-Alliance/ltp.git"
META_CHERI_LTP_BRANCH ?= "master"
META_CHERI_LTP_PROTOCOL ?= "https"

META_CHERI_MUSL_REPO ?= "github.com/CHERI-Alliance/musl.git"
META_CHERI_MUSL_BRANCH ?= "codasip-cheri-riscv"
META_CHERI_MUSL_PROTOCOL ?= "https"

META_CHERI_OPENSBI_REPO ?= "github.com/CHERI-Alliance/opensbi.git"
META_CHERI_OPENSBI_BRANCH ?= "codasip-cheri-riscv"
META_CHERI_OPENSBI_PROTOCOL ?= "https"

META_CHERI_OPENOCD_REPO ?= "github.com/CHERI-Alliance/openocd.git"
META_CHERI_OPENOCD_BRANCH ?= "codasip-cheri-riscv"
META_CHERI_OPENOCD_PROTOCOL ?= "https"

META_CHERI_QEMU_REPO = "github.com/CHERI-Alliance/qemu.git"
META_CHERI_QEMU_BRANCH = "alliance-codasip"
META_CHERI_QEMU_PROTOCOL = "https"

META_CHERI_U_BOOT_REPO ?= "github.com/CHERI-Alliance/u-boot.git"
META_CHERI_U_BOOT_BRANCH ?= "codasip-cheri-riscv"
META_CHERI_U_BOOT_PROTOCOL ?= "https"

# Suport for CHERI
DISTROOVERRIDES:append = "${@bb.utils.contains('DISTRO_FEATURES', 'cheri', ':cheri', '', d)}"
DISTRO_FEATURES_FILTER_NATIVE:append = " cheri"
DISTRO_FEATURES_FILTER_NATIVESDK:append = " cheri"

# Override the meta-clang's nonclangable
require conf/nonclangable-cheri.conf
```

## conf/machine/include/riscv/tune-riscv-cheri.inc
```bitbake
require arch-riscv-cheri.inc

TUNEVALID[riscv64cheri] = "Enable 64-bit RISC-V with CHERI extension"

AVAILTUNES += "riscv64cheri"

TUNE_FEATURES:tune-riscv64cheri = "${TUNE_FEATURES:tune-riscv64} riscv64cheri"
TUNE_ARCH:tune-riscv64cheri = "riscv64"
TUNE_PKGARCH:tune-riscv64cheri = "riscv64cheri"
PACKAGE_EXTRA_ARCHS:tune-riscv64cheri = "riscv64cheri"
```

## meta-cheri-bsp/conf/machine/include/riscv/arch-riscv-cheri.inc
```bitbake
# RISC-V Architecture with CHERI extension definition

TUNE_CCARGS:append = " ${@ \
  { \
    '' : '', \
    'codasip-lux' : \
      '-march=rv64imafdc_zicbom_zicbop_zicboz_zicntr_zicsr_zifencei_zfhmin_zca_zcb_zcd_zba_zbb_zbkc_zbs -mabi=lp64d', \
    'riscv64cheri' : \
      '-march=rv64imafdc_zcherihybrid_zcherilevels -mabi=l64pc128d', \
    'codasip-lux riscv64cheri' : \
      '-march=rv64imafdc_zicbom_zicbop_zicboz_zicntr_zicsr_zifencei_zfhmin_zca_zcb_zcd_zba_zbb_zbkc_zbs_zcherihybrid_zcherilevels_zish4add -mabi=l64pc128d', \
  }[bb.utils.filter('TUNE_FEATURES', 'codasip-lux riscv64cheri', d)] \
}\
"
```

## meta-cheri-distro/conf/layer.conf
```bitbake
# We have a conf and classes directory, add to BBPATH
BBPATH .= ":${LAYERDIR}"

# We have recipes-* directories, add to BBFILES
BBFILES += "${LAYERDIR}/recipes-*/*/*.bb ${LAYERDIR}/recipes-*/*/*.bbappend"

BBFILE_COLLECTIONS += "meta-cheri-distro"
BBFILE_PATTERN_meta-cheri-distro = "^${LAYERDIR}/"
BBFILE_PRIORITY_meta-cheri-distro = "15"

BBFILES_DYNAMIC += " \
    openembedded-layer:${LAYERDIR}/dynamic-layers/openembedded-layer/*/*/*.bb \
    openembedded-layer:${LAYERDIR}/dynamic-layers/openembedded-layer/*/*/*.bbappend \
    gnome-layer:${LAYERDIR}/dynamic-layers/gnome-layer/*/*/*.bbappend \
    networking-layer:${LAYERDIR}/dynamic-layers/networking-layer/*/*/*.bbappend \
    multimedia-layer:${LAYERDIR}/dynamic-layers/multimedia-layer/*/*/*.bbappend \
"

LAYERDEPENDS_meta-cheri-distro = " meta-cheri-toolchain"

# This should only be incremented on significant changes that will
# cause compatibility issues with other layers
LAYERVERSION_meta-cheri-distro = "1"

LAYERSERIES_COMPAT_meta-cheri-distro = "scarthgap"

META_CHERI_BUSYBOX_REPO ?= "github.com/CHERI-Alliance/busybox.git"
META_CHERI_BUSYBOX_BRANCH ?= "codasip-cheri-riscv-1_36_1"
META_CHERI_BUSYBOX_PROTOCOL ?= "https"

META_CHERI_GDB_REPO = "github.com/CHERI-Alliance/gdb.git"
META_CHERI_GDB_BRANCH = "codasip-cheri-riscv"
META_CHERI_GDB_PROTOCOL = "https"

META_CHERI_OPENOCD_REPO ?= "github.com/CHERI-Alliance/openocd.git"
META_CHERI_OPENOCD_BRANCH ?= "codasip-cheri-riscv"
META_CHERI_OPENOCD_PROTOCOL ?= "https"

# Suport for CHERI
DISTROOVERRIDES:append = "${@bb.utils.contains('DISTRO_FEATURES', 'cheri', ':cheri', '', d)}"
DISTRO_FEATURES_FILTER_NATIVE:append = " cheri"
DISTRO_FEATURES_FILTER_NATIVESDK:append = " cheri"
```
